## CMakeLists.txt
```
# SPDX-License-Identifier: Apache-2.0
#
# cpu1's image for the dual-core subsystem - only built when the main
# app (../CMakeLists.txt) is built with sysbuild (west build --sysbuild).
# See ../README.md and ../sysbuild.cmake/Kconfig.sysbuild.

cmake_minimum_required(VERSION 3.20.0)

find_package(Zephyr REQUIRED HINTS $ENV{ZEPHYR_BASE})
project(mcx-n9xx-evk-remote)

target_sources(app PRIVATE src/main.c)
```

## prj.conf
```kconfig
# cpu1 has its own console UART wired to a different physical header
# (flexcomm2_lpuart2) than cpu0's (flexcomm4_lpuart4) - rather than
# require a second serial adapter just to observe it, cpu1 stays
# headless and communicates purely over the mailbox; all verification
# happens from cpu0's already-working console (see ../README.md).
CONFIG_STDOUT_CONSOLE=n
CONFIG_MBOX=y
```

## boards/mcx_n9xx_evk_mcxn947_cpu1.overlay
```dts
/*
 * Mirror image of ../../boards/mcx_n9xx_evk_mcxn947_cpu0.overlay's
 * mbox-consumer node, with tx/rx channels swapped so each core's "tx"
 * is the other's "rx".
 */
/ {
	mbox-consumer {
		compatible = "vnd,mbox-consumer";
		mboxes = <&mbox 0>, <&mbox 1>;
		mbox-names = "tx", "rx";
	};
};
```

## src/main.c
```c
/*
 * Copyright (c) Meta Platforms, Inc. and affiliates.
 *
 * Licensed under the Apache License, Version 2.0 (the "License");
 * you may not use this file except in compliance with the License.
 * You may obtain a copy of the License at
 *
 *     http://www.apache.org/licenses/LICENSE-2.0
 *
 * Unless required by applicable law or agreed to in writing, software
 * distributed under the License is distributed on an "AS IS" BASIS,
 * WITHOUT WARRANTIES OR CONDITIONS OF ANY KIND, either express or implied.
 * See the License for the specific language governing permissions and
 * limitations under the License.
 *
 * cpu1's image for the dual-core subsystem. Headless (no wired
 * console - see prj.conf): on receiving a ping from cpu0 over the
 * mailbox, immediately echoes a reply back, so cpu0's own console log
 * ("pong from cpu1") is direct proof cpu1 actually received and
 * reacted to it - not just two independent unrelated timers.
 */

#include <zephyr/kernel.h>
#include <zephyr/drivers/mbox.h>

static const struct mbox_dt_spec tx_channel = MBOX_DT_SPEC_GET(DT_PATH(mbox_consumer), tx);
static const struct mbox_dt_spec rx_channel = MBOX_DT_SPEC_GET(DT_PATH(mbox_consumer), rx);

static void mbox_callback(const struct device *dev, mbox_channel_id_t channel_id, void *user_data,
			   struct mbox_msg *data)
{
	ARG_UNUSED(dev);
	ARG_UNUSED(channel_id);
	ARG_UNUSED(user_data);
	ARG_UNUSED(data);

	mbox_send_dt(&tx_channel, NULL);
}

int main(void)
{
	if (!device_is_ready(tx_channel.dev) || !device_is_ready(rx_channel.dev)) {
		return 0;
	}

	if (mbox_register_callback_dt(&rx_channel, mbox_callback, NULL) < 0) {
		return 0;
	}

	mbox_set_enabled_dt(&rx_channel, true);

	return 0;
}
```
