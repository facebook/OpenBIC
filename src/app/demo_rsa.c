/*
 * Copyright (c) Aspeed Technology Inc.
 *
 * SPDX-License-Identifier: Apache-2.0
 */
#include <stdio.h>
#include "stdlib.h"
#include "cmsis_os.h"
#include "board_device.h"
#include "objects.h"
#include "crypto_aspeed.h"
#include "getopt.h"
#include "FreeRTOS_CLI.h"
#include "log.h"

rsa_t rsa;
extern aspeed_device_t rsa_dev;
static const CLI_Command_Definition_t rsa_cmd;

struct rsa_testvec {
	struct rsa_key k;
	char *p;
	char *c;
	unsigned int p_size;
	unsigned int c_size;
};

static const struct rsa_testvec rsa_tv[] = {
	{
		.k = {
			.m =
			"\xDB\x10\x1A\xC2\xA3\xF1\xDC\xFF\x13\x6B\xED\x44\xDF\xF0\x02\x6D"
			"\x13\xC7\x88\xDA\x70\x6B\x54\xF1\xE8\x27\xDC\xC3\x0F\x99\x6A\xFA"
			"\xC6\x67\xFF\x1D\x1E\x3C\x1D\xC1\xB5\x5F\x6C\xC0\xB2\x07\x3A\x6D"
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			"\xD6\xB0\xE2\x62\x8F\x74\x26\xC2\x0C\xD3\x9A\x17\x47\xE6\x8E\xAB",
			.d =
			"\x52\x41\xF4\xDA\x7B\xB7\x59\x55\xCA\xD4\x2F\x0F\x3A\xCB\xA4\x0D"
			"\x93\x6C\xCC\x9D\xC1\xB2\xFB\xFD\xAE\x40\x31\xAC\x69\x52\x21\x92"
			"\xB3\x27\xDF\xEA\xEE\x2C\x82\xBB\xF7\x40\x32\xD5\x14\xC4\x94\x12"
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			"\xA7\x1D\xD9\x1E\x06\xCD\xE8\xBA\x2C\x8C\x69\x32\xEA\xBE\x60\x71",
			.e = "\x01\x00\x01",
			.m_bits = 2048,
			.d_bits = 2048,
			.e_bits = 24
		},
		.p = "\x54\x85\x9b\x34\x2c\x49\xea\x2a",
		.c =
		"\xb2\x97\x76\xb4\xae\x3e\x38\x3c\x7e\x64\x1f\xcc\xa2\x7f\xf6\xbe"
		"\xcf\x49\xbc\x48\xd3\x6c\x8f\x0a\x0e\xc1\x73\xbd\x7b\x55\x79\x36"
		"\x0e\xa1\x87\x88\xb9\x2c\x90\xa6\x53\x5e\xe9\xef\xc4\xe2\x4d\xdd"
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		"\x5d\x59\xc3\x62\xd5\xa6\xda\x38\x26\x22\x5e\x34\x1c\x94\xaf\x98",
		.p_size = 8,
		.c_size = 256,
	},
	{
		.k = {
			.m =
			"\x00\xAA\x36\xAB\xCE\x88\xAC\xFD\xFF\x55\x52\x3C\x7F\xC4\x52\x3F"
			"\x90\xEF\xA0\x0D\xF3\x77\x4A\x25\x9F\x2E\x62\xB4\xC5\xD9\x9C\xB5"
			"\xAD\xB3\x00\xA0\x28\x5E\x53\x01\x93\x0E\x0C\x70\xFB\x68\x76\x93"
			"\x9C\xE6\x16\xCE\x62\x4A\x11\xE0\x08\x6D\x34\x1E\xBC\xAC\xA0\xA1"
			"\xF5",
			.d =
			"\x0A\x03\x37\x48\x62\x64\x87\x69\x5F\x5F\x30\xBC\x38\xB9\x8B\x44"
			"\xC2\xCD\x2D\xFF\x43\x40\x98\xCD\x20\xD8\xA1\x38\xD0\x90\xBF\x64"
			"\x79\x7C\x3F\xA7\xA2\xCD\xCB\x3C\xD1\xE0\xBD\xBA\x26\x54\xB4\xF9"
			"\xDF\x8E\x8A\xE5\x9D\x73\x3D\x9F\x33\xB3\x01\x62\x4A\xFD\x1D\x51",
			.e = "\x11",
			.m_bits = 520,
			.d_bits = 512,
			.e_bits = 8
		},
		.p = "\x54\x85\x9b\x34\x2c\x49\xea\x2a",
		.c =
		"\x63\x1c\xcd\x7b\xe1\x7e\xe4\xde\xc9\xa8\x89\xa1\x74\xcb\x3c\x63"
		"\x7d\x24\xec\x83\xc3\x15\xe4\x7f\x73\x05\x34\xd1\xec\x22\xbb\x8a"
		"\x5e\x32\x39\x6d\xc1\x1d\x7d\x50\x3b\x9f\x7a\xad\xf0\x2e\x25\x53"
		"\x9f\x6e\xbd\x4c\x55\x84\x0c\x9b\xcf\x1a\x4b\x51\x1e\x9e\x0c\x06",
		.p_size = 8,
		.c_size = 64,
	}
};

static void rsa_test()
{
	struct rsa_key *rk;
	char plain_text[512];
	char cipher_text[512];
	int i, j;
	int ret;

	for (i = 0; i < ARRAY_SIZE(rsa_tv); i++) {
		printf("rsa test vector[%d]:\n", i);
		rk = &rsa_tv[i].k;
		// sprintf(plain_text, rsa_tv[i].p);
		aspeed_rsa_enc(rsa_tv[i].p, rsa_tv[i].p_size, cipher_text, rk);
		ret = memcmp(cipher_text, rsa_tv[i].c, rsa_tv[i].c_size);
		if (ret != 0) {
			printf("enc fail: %d\n", ret);
			printf("input text:\n");
			for (j = 0; j < rsa_tv[i].p_size; j++) {
				printf("%02x", rsa_tv[i].p[j]);
				if ((j + 1) % 32 == 0)
					printf("\n");
			}
			printf("\n");
			printf("result text:\n");
			for (j = 0; j < rsa_tv[i].c_size; j++) {
				printf("%02x", cipher_text[j]);
				if ((j + 1) % 32 == 0)
					printf("\n");
			}
		} else {
			printf("enc pass\n");
		}

		aspeed_rsa_dec(cipher_text, rsa_tv[i].c_size, plain_text, rk);
		ret = memcmp(plain_text, rsa_tv[i].p, rsa_tv[i].p_size);
		if (ret != 0) {
			printf("dec fail: %d\n", ret);
			printf("input text:\n");
			for (j = 0; j < rsa_tv[i].c_size; j++) {
				printf("%02x", cipher_text[j]);
				if ((j + 1) % 32 == 0)
					printf("\n");
			}
			printf("result text:\n");
			for (j = 0; j < rsa_tv[i].p_size; j++) {
				printf("%02x", plain_text[j]);
				if ((j + 1) % 32 == 0)
					printf("\n");
			}
		} else {
			printf("dec pass\n");
		}

	}
}

static void rsa_stress(void *argv)
{
	struct rsa_key *rk;
	char plain_text[512];
	char cipher_text[512];
	int i, j;
	int ret;

	j = 0;
	for (;; j++) {
		for (i = 0; i < ARRAY_SIZE(rsa_tv); i++) {
			rk = &rsa_tv[i].k;
			// sprintf(plain_text, rsa_tv[i].p);
			aspeed_rsa_enc(rsa_tv[i].p, rsa_tv[i].p_size, cipher_text, rk);
			ret = memcmp(cipher_text, rsa_tv[i].c, rsa_tv[i].c_size);
			if (ret != 0) {
				log_error("enc fail: %d\n", ret);
			}
			aspeed_rsa_dec(cipher_text, rsa_tv[i].c_size, plain_text, rk);
			ret = memcmp(plain_text, rsa_tv[i].p, rsa_tv[i].p_size);
			if (ret != 0) {
				log_error("dec fail: %d\n", ret);
			}
		}
		if (j % 10 == 0) {
			log_info("rsa finish %d times\n", j);
		}

		osDelay(1000);
	}
}

static osThreadId_t tid_rsa_task;
static osThreadAttr_t tattr_rsa_task;

static void rsa_cmd_handler(int argc, char *argv[])
{
	char option;
	bool test = 0;
	bool stress = 0;

	optind = 0;
	while ((option = getopt(argc, argv, "hts")) != (char) -1) {
		switch (option) {
		case 'h':
		case '?':
			printf("%s", rsa_cmd.pcHelpString);
			return;
		case 't':
			test = 1;
			break;
		case 's':
			stress = 1;
			break;
		default:
			log_warn("unknown option -%c", option);
			break;
		}
	}

	if (stress) {
		tattr_rsa_task.name = "rsa_stress";
		tattr_rsa_task.priority = osPriorityBelowNormal;
		tattr_rsa_task.stack_size = 0x1000;

		tid_rsa_task = osThreadNew(rsa_stress, NULL, &tattr_rsa_task);
		return;
	}

	if (test) {
		rsa_test();
		return;
	}

}

CLI_FUNC_DECL(rsa, rsa_cmd_handler);

static const CLI_Command_Definition_t rsa_cmd = {
	"rsa",
	"\r\nrsa:\n \
	usage:\r\n \
		[-h]: Show this message\r\n \
		[-t]: test rsa\r\n \
		[-s]: stress test\r\n",
	CLI_FUNC_SYM(rsa),
	-1
};

void demo_rsa_init(void)
{
	rsa.device = &rsa_dev;
	aspeed_rsa_init(&rsa);

	FreeRTOS_CLIRegisterCommand(&rsa_cmd);
}
