## src/board/fpga-ast2600/Kconfig
```kconfig
if TARGET_FPGA_AST2600
config BOARD_VENDOR
	default "aspeed"

config BOARD_NAME
	default "fpga-ast2600"

config IMG_NAME
	default "ast2600_ssp.bin"

endif
```

## src/board/yv35-cl/Kconfig
```kconfig
if TARGET_YV35_CL
config BOARD_VENDOR
	default "aspeed"

config BOARD_NAME
	default "yv35-cl"

config IMG_NAME
	default "Y35BCL.bin"

config ARM_ICE
	bool "Arm ICE debug enable"
	default y
endif
```

## src/configs/evb-ast1030-net_defconfig
```kconfig
CONFIG_AST1030_SERIES=y
CONFIG_TARGET_EVB_AST1030=y
CONFIG_TOTAL_HEAP_SIZE=98304
CONFIG_DEMO_NET=y
CONFIG_DEVICE_MAC=y
CONFIG_DEVICE_MDIO=y
# CONFIG_DEVICE_FMC_SPI is not set
# CONFIG_DEVICE_WDT is not set
```

## src/configs/evb-ast1030_defconfig
```kconfig
CONFIG_AST1030_SERIES=y
CONFIG_TARGET_EVB_AST1030=y
CONFIG_TOTAL_HEAP_SIZE=98304
CONFIG_DEMO_GPIO=y
CONFIG_DEMO_I2C=y
CONFIG_DEMO_I3C=y
CONFIG_DEMO_ESPI=y
CONFIG_DEMO_PECI=y
CONFIG_DEMO_PWM_TACH=y
CONFIG_DEMO_ADC=y
CONFIG_DEMO_JTAG=y
CONFIG_SVF=y
CONFIG_DEMO_KCS=y
CONFIG_DEMO_BT=y
CONFIG_DEMO_SNOOP=y
CONFIG_DEMO_PCC=y
CONFIG_DEMO_USB=y
CONFIG_DEMO_FMC_SPI=y
CONFIG_DEMO_RSA=y
CONFIG_DEVICE_I2C=y
CONFIG_DEVICE_I3C=y
CONFIG_DEVICE_ESPI=y
CONFIG_DEVICE_PECI=y
CONFIG_DEVICE_GPIO=y
CONFIG_DEVICE_SGPIOM=y
CONFIG_DEVICE_PWM_TACH=y
CONFIG_DEVICE_ADC=y
CONFIG_DEVICE_JTAG=y
CONFIG_DEVICE_KCS=y
CONFIG_DEVICE_BT=y
CONFIG_DEVICE_SNOOP=y
CONFIG_DEVICE_PCC=y
CONFIG_DEVICE_USB=y
CONFIG_DEVICE_CRYPTO=y
```

## src/configs/evb-ast2600-full_defconfig
```kconfig
#
# Architecture select
#
CONFIG_ARM=y
# end of Architecture select

#
# ARM architecture
#
CONFIG_ARCH_ASPEED=y
CONFIG_SOC_VENDOR="aspeed"
CONFIG_AST2600_SERIES=y
# CONFIG_AST1030_SERIES is not set
# CONFIG_AST2600A0 is not set
# CONFIG_AST2600A1 is not set
CONFIG_AST2600A2=y
CONFIG_CPU_ID="cortex-m3"
CONFIG_CPU_ARCH="armv7-m"
CONFIG_FPU_SELECT=""
CONFIG_SOC_INCLUDE_FILE="ast2600.h"
# end of ARM architecture

#
# Board select
#
CONFIG_TARGET_EVB_AST2600=y
# CONFIG_TARGET_FPGA_AST2600 is not set
CONFIG_BOARD_VENDOR="aspeed"
CONFIG_BOARD_NAME="evb-ast2600"
# end of Board select

#
# Debug
#
CONFIG_STDIO_UART=10
# CONFIG_PRINT_REG_W is not set
# CONFIG_PINCTRL_NAME_TABLE is not set
# end of Debug

#
# FreeRTOS kernel
#
CONFIG_USE_PREEMPTION=y
# CONFIG_USE_CO_ROUTINES is not set
# CONFIG_HEAP_1 is not set
# CONFIG_HEAP_2 is not set
# CONFIG_HEAP_3 is not set
CONFIG_HEAP_4=y
# CONFIG_HEAP_5 is not set
CONFIG_APPLICATION_ALLOCATED_HEAP=1
CONFIG_TOTAL_HEAP_SIZE=65536
CONFIG_TOTAL_HEAP_NC_SIZE=32768
# end of FreeRTOS kernel

#
# FreeRTOS CLI
#
CONFIG_CLI_BAUD_RATE=115200
CONFIG_CMD_HISTORY_SIZE=10
CONFIG_CMD_MAX_INPUT_SIZE=50
CONFIG_CMD_MAX_INPUT_ARGS=10
CONFIG_INCLUDE_QUERY_HEAP_COMMAND=y
# end of FreeRTOS CLI

#
# Aspeed commands
#
CONFIG_CMD_MEM=y
CONFIG_CMD_CLK=y
# end of Aspeed commands

#
# Demo APPs
#
CONFIG_DEMO_TASK_SW=y
CONFIG_DEMO_GPIO=y
CONFIG_DEMO_I2C=y
CONFIG_DEMO_I3C=y
CONFIG_DEMO_I3C_CASE_1=y
# CONFIG_DEMO_I3C_CASE_2 is not set
# CONFIG_DEMO_I3C_CASE_3 is not set
CONFIG_DEMO_ESPI=y
CONFIG_DEMO_PECI=y
CONFIG_DEMO_PWM_TACH=y
CONFIG_DEMO_ADC=y
CONFIG_DEMO_JTAG=y
CONFIG_SVF=y
CONFIG_DEMO_KCS=y
CONFIG_DEMO_BT=y
CONFIG_DEMO_SNOOP=y
CONFIG_DEMO_PCC=y
CONFIG_DEMO_USB=y
CONFIG_DEMO_CMB=y
CONFIG_DEMO_NET=y
CONFIG_DEMO_MDIO=y
CONFIG_DEMO_FMC_SPI=y
# end of Demo APPs

#
# Devices
#
CONFIG_DEVICE_SERIAL=y
CONFIG_DEVICE_TIMER=y
CONFIG_DEVICE_DELAY_TIMER=0
CONFIG_DEVICE_I2C=y
CONFIG_DEVICE_I3C=y
CONFIG_DEVICE_I3CDMA=y
CONFIG_I3C_IBI=y
CONFIG_DEVICE_IPI=y
CONFIG_DEVICE_ESPI=y
CONFIG_DEVICE_ESPI_HOST_MAP_ADDR=0x98000000
CONFIG_DEVICE_ESPI_HOST_MAP_SIZE=0x10000
CONFIG_DEVICE_PECI=y
CONFIG_DEVICE_PECI_CMD_TIMEOUT=1000
CONFIG_DEVICE_GPIO=y
CONFIG_DEVICE_SGPIOM=y
CONFIG_DEVICE_PWM_TACH=y
CONFIG_DEVICE_ADC=y
CONFIG_DEVICE_JTAG=y
CONFIG_DEVICE_KCS=y
CONFIG_DEVICE_BT=y
CONFIG_DEVICE_SNOOP=y
CONFIG_DEVICE_PCC=y
CONFIG_DEVICE_USB=y
CONFIG_DEVICE_MAC=y
CONFIG_DEVICE_MDIO=y
CONFIG_DEVICE_FMC_SPI=y
# end of Devices

#
# Libraries
#
CONFIG_LIBRARIES_LOG=y
CONFIG_LOG_LEVEL=2
# CONFIG_LOG_COLOR is not set
CONFIG_LIBRARIES_CMBACKTRACE=y
CONFIG_OS_PLATFORM_FREERTOS=y
# CONFIG_BARE_METAL is not set
# CONFIG_OS_PLATFORM_RTT is not set
# CONFIG_OS_PLATFORM_UCOSII is not set
# CONFIG_OS_PLATFORM_UCOSIII is not set
CONFIG_CMB_OS_TYPE=3
CONFIG_ARM_CORTEX_M3=y
# CONFIG_ARM_CORTEX_M4 is not set
# CONFIG_ARM_CORTEX_M0 is not set
# CONFIG_ARM_CORTEX_M7 is not set
CONFIG_CMB_CPU_TYPE=1
# end of Libraries

# CONFIG_OTP_MEM is not set
# CONFIG_SB_ENABLE is not set
```

## src/configs/evb-ast2600-net_defconfig
```kconfig
CONFIG_AST2600A2=y
CONFIG_STDIO_UART=10
CONFIG_CHECK_FOR_STACK_OVERFLOW=2
CONFIG_DEMO_NET=y
# CONFIG_DEVICE_TIMER is not set
CONFIG_DEVICE_MAC=y
CONFIG_DEVICE_MDIO=y
# CONFIG_DEVICE_WDT is not set
```

## src/configs/evb-ast2600_defconfig
```kconfig
CONFIG_ARM=y
CONFIG_ARCH_ASPEED=y
CONFIG_SOC_VENDOR="aspeed"
CONFIG_TARGET_EVB_AST2600=y
CONFIG_AST2600_SERIES=y
CONFIG_AST2600A2=y
CONFIG_CPU_ID="cortex-m3"
CONFIG_CPU_ARCH="armv7-m"
CONFIG_SOC_INCLUDE_FILE="ast2600.h"
CONFIG_STDIO_UART=10
CONFIG_HEAP_4=y
CONFIG_USE_PREEMPTION=y
CONFIG_CHECK_FOR_STACK_OVERFLOW=2
CONFIG_CLI_BAUD_RATE=115200
CONFIG_INCLUDE_QUERY_HEAP_COMMAND=y
CONFIG_CMD_MEM=y
CONFIG_DEVICE_SERIAL=y
CONFIG_DEVICE_TIMER=n
```

## src/configs/evb-ast2600a1_defconfig
```kconfig
CONFIG_STDIO_UART=10
# CONFIG_DEVICE_TIMER is not set
# CONFIG_DEVICE_WDT is not set
```

## src/configs/evb-ast2605-full_defconfig
```kconfig
CONFIG_AST2600A2=y
CONFIG_TARGET_EVB_AST2605=y
CONFIG_STDIO_UART=10
CONFIG_CHECK_FOR_STACK_OVERFLOW=2
CONFIG_DEMO_I2C=y
CONFIG_DEMO_KCS=y
CONFIG_DEMO_BT=y
CONFIG_DEMO_SNOOP=y
CONFIG_DEMO_PCC=y
# CONFIG_DEVICE_TIMER is not set
CONFIG_DEVICE_I2C=y
CONFIG_DEVICE_GPIO=y
CONFIG_DEVICE_SGPIOM=y
CONFIG_DEVICE_KCS=y
CONFIG_DEVICE_BT=y
CONFIG_DEVICE_SNOOP=y
CONFIG_DEVICE_PCC=y
# CONFIG_LIBRARIES_LOG is not set
# CONFIG_LIBRARIES_CMBACKTRACE is not set
```

## src/configs/evb-ast2605_defconfig
```kconfig
CONFIG_AST2600A2=y
CONFIG_TARGET_EVB_AST2605=y
CONFIG_STDIO_UART=10
CONFIG_CHECK_FOR_STACK_OVERFLOW=2
# CONFIG_DEVICE_TIMER is not set
# CONFIG_DEVICE_FMC_SPI is not set
```

## src/configs/fpga-ast1030_defconfig
```kconfig
#
# Architecture select
#
CONFIG_ARM=y
# end of Architecture select

#
# ARM architecture
#
CONFIG_ARCH_ASPEED=y
CONFIG_SOC_VENDOR="aspeed"
# CONFIG_AST2600_SERIES is not set
CONFIG_AST1030_SERIES=y
CONFIG_AST1030A0=y
CONFIG_CPU_ID="cortex-m4"
CONFIG_CPU_ARCH="armv7e-m"
CONFIG_FPU_SELECT="-mfloat-abi=hard -mfpu=fpv4-sp-d16"
CONFIG_SOC_INCLUDE_FILE="ast1030.h"
# end of ARM architecture

#
# Board select
#
# CONFIG_TARGET_EVB_AST1030A0 is not set
CONFIG_TARGET_FPGA_AST1030=y
# end of Board select

#
# Debug
#
CONFIG_STDIO_UART=4
# CONFIG_PRINT_REG_W is not set
# end of Debug

#
# FreeRTOS kernel
#
CONFIG_USE_PREEMPTION=y
# CONFIG_USE_CO_ROUTINES is not set
# CONFIG_HEAP_1 is not set
# CONFIG_HEAP_2 is not set
# CONFIG_HEAP_3 is not set
CONFIG_HEAP_4=y
# CONFIG_HEAP_5 is not set
# end of FreeRTOS kernel

#
# FreeRTOS CLI
#
CONFIG_CLI_BAUD_RATE=115200
CONFIG_INCLUDE_QUERY_HEAP_COMMAND=y
# end of FreeRTOS CLI

#
# Aspeed commands
#
CONFIG_CMD_MEM=y
# end of Aspeed commands

#
# Demo APPs
#
# CONFIG_DEMO_TASK_SW is not set
# end of Demo APPs

#
# Devices
#
CONFIG_DEVICE_SERIAL=y
# CONFIG_DEVICE_I2C is not set
# CONFIG_DEVICE_I3C is not set
# CONFIG_DEVICE_IPI is not set
# end of Devices
```

## src/configs/fpga-ast1030_sec_defconfig
```kconfig
#
# Architecture select
#
CONFIG_ARM=y
# end of Architecture select

#
# ARM architecture
#
CONFIG_ARCH_ASPEED=y
CONFIG_SOC_VENDOR="aspeed"
# CONFIG_AST2600_SERIES is not set
CONFIG_AST1030_SERIES=y
CONFIG_AST1030A0=y
CONFIG_CPU_ID="cortex-m4"
CONFIG_CPU_ARCH="armv7e-m"
CONFIG_FPU_SELECT="-mfloat-abi=hard -mfpu=fpv4-sp-d16"
CONFIG_SOC_INCLUDE_FILE="ast1030.h"
# end of ARM architecture

#
# Board select
#
# CONFIG_TARGET_EVB_AST1030A0 is not set
CONFIG_TARGET_FPGA_AST1030=y
CONFIG_BOARD_VENDOR="aspeed"
CONFIG_BOARD_NAME="fpga-ast1030"
# end of Board select

#
# Debug
#
CONFIG_STDIO_UART=4
# CONFIG_PRINT_REG_W is not set
# end of Debug

#
# FreeRTOS kernel
#
CONFIG_USE_PREEMPTION=y
# CONFIG_USE_CO_ROUTINES is not set
# CONFIG_HEAP_1 is not set
# CONFIG_HEAP_2 is not set
# CONFIG_HEAP_3 is not set
CONFIG_HEAP_4=y
# CONFIG_HEAP_5 is not set
CONFIG_APPLICATION_ALLOCATED_HEAP=1
CONFIG_TOTAL_HEAP_SIZE=65536
CONFIG_TOTAL_HEAP_NC_SIZE=32768
# end of FreeRTOS kernel

#
# FreeRTOS CLI
#
CONFIG_CLI_BAUD_RATE=115200
CONFIG_INCLUDE_QUERY_HEAP_COMMAND=y
# end of FreeRTOS CLI

#
# Aspeed commands
#
CONFIG_CMD_MEM=y
CONFIG_CMD_CLK=y
# end of Aspeed commands

#
# Demo APPs
#
# CONFIG_DEMO_TASK_SW is not set
# CONFIG_DEMO_CMB is not set
# CONFIG_DEMO_NET is not set
# end of Demo APPs

#
# Devices
#
CONFIG_DEVICE_SERIAL=y
CONFIG_DEVICE_TIMER=y
CONFIG_DEVICE_DELAY_TIMER=0
# CONFIG_DEVICE_I2C is not set
# CONFIG_DEVICE_I3C is not set
# CONFIG_DEVICE_IPI is not set
# CONFIG_DEVICE_ESPI is not set
# CONFIG_DEVICE_PECI is not set
# CONFIG_DEVICE_PWM_TACH is not set
# CONFIG_DEVICE_KCS is not set
# CONFIG_DEVICE_BT is not set
# CONFIG_DEVICE_SNOOP is not set
# CONFIG_DEVICE_PCC is not set
# CONFIG_DEVICE_USB is not set
# CONFIG_DEVICE_MAC is not set
# CONFIG_DEVICE_MDIO is not set
# CONFIG_DEVICE_FMC_SPI is not set
# end of Devices

#
# Libraries
#
CONFIG_LIBRARIES_LOG=y
CONFIG_LOG_LEVEL=2
# CONFIG_LOG_COLOR is not set
CONFIG_LIBRARIES_CMBACKTRACE=y
CONFIG_OS_PLATFORM_FREERTOS=y
# CONFIG_BARE_METAL is not set
# CONFIG_OS_PLATFORM_RTT is not set
# CONFIG_OS_PLATFORM_UCOSII is not set
# CONFIG_OS_PLATFORM_UCOSIII is not set
CONFIG_CMB_OS_TYPE=3
CONFIG_ARM_CORTEX_M3=y
# CONFIG_ARM_CORTEX_M4 is not set
# CONFIG_ARM_CORTEX_M0 is not set
# CONFIG_ARM_CORTEX_M7 is not set
CONFIG_CMB_CPU_TYPE=1
# end of Libraries

# CONFIG_OTP_MEM is not set
# CONFIG_SB_ENABLE is not set

CONFIG_OTP_MEM=y
CONFIG_OTP_CONFIG="configs/otp_config/mini_RSA2048_SHA256.json"
CONFIG_OTP_KEY_FOLDER="configs/key"
CONFIG_OTP_USER_DATA_FOLDER="configs/data"
# CONFIG_OTP_FPGA is not set
CONFIG_SB_ENABLE=y
CONFIG_SB_MODE_2=y
# CONFIG_SB_MODE_GCM is not set
# CONFIG_SB_MODE_2_AES is not set
# CONFIG_SB_RSA_1024 is not set
CONFIG_SB_RSA_2048=y
# CONFIG_SB_RSA_3072 is not set
# CONFIG_SB_RSA_4096 is not set
# CONFIG_SB_SHA_224 is not set
CONFIG_SB_SHA_256=y
# CONFIG_SB_SHA_384 is not set
# CONFIG_SB_SHA_512 is not set
CONFIG_SB_RSA_KEY="configs/key/test_oem_dss_private_key_2048_1.pem"
```

## src/configs/yv35_cl_defconfig
```kconfig
CONFIG_AST1030_SERIES=y
CONFIG_TARGET_YV35_CL=y
CONFIG_TOTAL_HEAP_SIZE=196608
CONFIG_DEMO_GPIO=y
CONFIG_DEMO_I2C=y
CONFIG_DEMO_I3C=n
CONFIG_DEMO_ESPI=y
CONFIG_DEMO_PECI=y
CONFIG_DEMO_PWM_TACH=n
CONFIG_DEMO_ADC=y
CONFIG_DEMO_JTAG=y
CONFIG_SVF=y
CONFIG_DEMO_KCS=n
CONFIG_DEMO_BT=n
CONFIG_DEMO_SNOOP=n
CONFIG_DEMO_PCC=y
CONFIG_DEMO_USB=y
CONFIG_DEMO_FMC_SPI=y
CONFIG_DEVICE_I2C=y
CONFIG_DEVICE_I3C=n
CONFIG_DEVICE_ESPI=y
CONFIG_DEVICE_PECI=y
CONFIG_DEVICE_GPIO=y
CONFIG_DEVICE_SGPIOM=n
CONFIG_DEVICE_PWM_TACH=n
CONFIG_DEVICE_ADC=y
CONFIG_DEVICE_JTAG=y
CONFIG_DEVICE_KCS=y
CONFIG_DEVICE_BT=n
CONFIG_DEVICE_SNOOP=n
CONFIG_DEVICE_PCC=y
CONFIG_DEVICE_USB=y
```

## src/drivers/Kconfig
```kconfig
menu "Devices"
config DEVICE_SERIAL
	bool "Serial device and driver"
	default y

config DEVICE_TIMER
	bool "Aspeed HW timer device and driver"
	default y

config DEVICE_DELAY_TIMER
	depends on DEVICE_TIMER
	int "Aspeed timer used for the delay function before OS kernel start"
	default 0

config DEVICE_I2C
	bool "I2C device and driver"
	default n

config DEVICE_I3C
	bool "I3C device and driver"
	default n

if DEVICE_I3C
config DEVICE_I3CDMA
	bool "I3C DMA device and driver"
	default n

config I3C_IBI
	bool "I3C in-band-interrupt support"
	default y

config I3C_IBI_MAX_PAYLOAD
	depends on I3C_IBI
	int "Max IBI payload size"
	default 124

config I3C_MRL
	int "Max read length"
	default 256
endif

config DEVICE_IPI
	bool "Inter-processor-interrupt device and driver"
	default n

config DEVICE_ESPI
	bool "eSPI device and driver"
	default n

config DEVICE_ESPI_HOST_MAP_ADDR
	depends on DEVICE_ESPI
	hex "Host mapping address of eSPI peripheral channel"
	default 0x98000000

config DEVICE_ESPI_HOST_MAP_SIZE
	depends on DEVICE_ESPI
	hex "Host mapping size of eSPI peripheral channel"
	default 0x10000

config DEVICE_PECI
	bool "PECI device and driver"
	default n	

config DEVICE_PECI_CMD_TIMEOUT
	depends on DEVICE_PECI
	int "Command timeout: unit is tick"
	default 1000

config DEVICE_GPIO
	bool "GPIO device and driver"
	default n

config DEVICE_SGPIOM
	bool "SGPIO master device and driver"
	default n

config DEVICE_PWM_TACH
	bool "PWM/TACH device and driver"
	default n

config DEVICE_ADC
	bool "ADC device and driver"
	default n

config DEVICE_JTAG
	bool "JTAG device and driver"
	default n

config DEVICE_KCS
	bool "IPMI KCS device and driver"
	default n

config DEVICE_BT
	bool "IPMI BT device and driver"
	default n

config DEVICE_SNOOP
	bool "LPC Snoop device and driver"
	default n

config DEVICE_PCC
	bool "LPC PCC device and driver"
	default n

config DEVICE_USB
	bool "USB device and driver"
	default n

config DEVICE_MAC
	bool "Ethernet MAC device and driver"
	default n

config DEVICE_MDIO
	bool "MDIO device and driver"
	default n

config DEVICE_FMC_SPI
	bool "FMC/SPI device and driver"
	default y

config DEVICE_WDT
	bool "Watchdog device and driver"
	default y

config WDT_TIMEOUT_MS
	depends on DEVICE_WDT
	int "Watchdog timeout value, unit is ms"
	default 2000
config WDT_RESET_MASK_1
	depends on DEVICE_WDT
	hex "Watchdog reset mask 1"
	default 0xffffffff
config WDT_RESET_MASK_2
	depends on DEVICE_WDT
	hex "Watchdog reset mask 2"
	default 0xffffffff

endmenu
```
