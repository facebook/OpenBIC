## meta-facebook/aalc-rpu/boards/ast1030_evb.conf
```kconfig
CONFIG_GPIO_ASPEED=y
CONFIG_SPI_ASPEED=y
CONFIG_I2C_ASPEED=y
CONFIG_ADC_ASPEED=y
CONFIG_USB_ASPEED=y
CONFIG_WDT_ASPEED=y
CONFIG_PWM_ASPEED=y
CONFIG_TACH_ASPEED=y

#USB
CONFIG_USB=y
CONFIG_USB_DEVICE_STACK=y
CONFIG_USB_DEVICE_PRODUCT="Zephyr CDC ACM"
CONFIG_USB_CDC_ACM=y
CONFIG_USB_CDC_ACM_RINGBUF_SIZE=576
CONFIG_USB_DEVICE_VID=0x1d6b
CONFIG_USB_DEVICE_PID=0x0104
CONFIG_LOG_BUFFER_SIZE=5120
#USB

CONFIG_SHELL_LOG_BACKEND=n
```

## meta-facebook/at-cb/boards/ast1030_evb.conf
```kconfig
CONFIG_GPIO_ASPEED=y
CONFIG_SPI_ASPEED=y
CONFIG_I2C_ASPEED=y
CONFIG_I3C_ASPEED=y
CONFIG_ADC_ASPEED=y
CONFIG_JTAG_ASPEED=y
CONFIG_USB_ASPEED=n
CONFIG_RSA_ASPEED=n
CONFIG_WDT_ASPEED=y
CONFIG_TACH_ASPEED=y
CONFIG_PWM_ASPEED=y

CONFIG_SYSTEM_WORKQUEUE_STACK_SIZE=2048
```

## meta-facebook/at-mc/boards/ast1030_evb.conf
```kconfig
CONFIG_GPIO_ASPEED_SGPIOM=n
CONFIG_GPIO_ASPEED=y
CONFIG_SPI_ASPEED=y
CONFIG_I2C_ASPEED=y
CONFIG_I3C_ASPEED=n
CONFIG_ADC_ASPEED=y
CONFIG_JTAG_ASPEED=y
CONFIG_USB_ASPEED=n
CONFIG_RSA_ASPEED=n
CONFIG_WDT_ASPEED=y

CONFIG_SYSTEM_WORKQUEUE_STACK_SIZE=2048
```

## meta-facebook/gt-cc/boards/ast1030_evb.conf
```kconfig
CONFIG_GPIO_ASPEED=y
CONFIG_SPI_ASPEED=y
CONFIG_I2C_ASPEED=y
CONFIG_ADC_ASPEED=y
CONFIG_JTAG_ASPEED=y
CONFIG_USB_ASPEED=y
CONFIG_WDT_ASPEED=y

CONFIG_SYSTEM_WORKQUEUE_STACK_SIZE=2048
```

## meta-facebook/gt-cc/sample.yaml
```yaml
tests:
  portability.cmsis_rtos_v2:
    tags: cmsis_rtos
sample:
  description: gt_tmp 
  name: tmp
common:
    tags: introduction
```

## meta-facebook/minerva-ag/boards/npcm400f_evb.conf
```kconfig
CONFIG_CLOCK_CONTROL_NPCM4XX=y
CONFIG_UART_NPCM4XX=y
CONFIG_PINMUX_NPCM4XX=y
CONFIG_GPIO_NPCM4XX=y
CONFIG_GPIO_NPCM4XX_RESET_SL_POWER_UP=y
CONFIG_WDT_NPCM4XX=y
CONFIG_NPCM4XX_MIWU=y
CONFIG_PECI_NPCM4XX=n
CONFIG_SPI_NPCM4XX_SPIM=y
CONFIG_SPI_NPCM4XX_FIU=y
CONFIG_SPIP_NPCM4XX=y
CONFIG_ESPI_NPCM4XX=y
CONFIG_IPMI_KCS_NPCM4XX=y
CONFIG_I2C_NPCM4XX=y
CONFIG_I3C_NPCM4XX=y
CONFIG_ADC_NPCM4XX=y
CONFIG_USB_DC_NPCM4XX=y
CONFIG_JTAG_NPCM4XX=y
CONFIG_LOG_STRDUP_BUF_COUNT=16
```

## meta-facebook/wc-mb/sample.yaml
```yaml
tests:
  portability.cmsis_rtos_v2:
    tags: cmsis_rtos
sample:
  description: wc_tmp
  name: tmp
common:
    tags: introduction
```

## meta-facebook/yv3-dl/boards/ast1030_evb.conf
```kconfig
CONFIG_GPIO_ASPEED_SGPIOM=n
CONFIG_GPIO_ASPEED=y
CONFIG_SPI_ASPEED=y
CONFIG_I2C_ASPEED=y
CONFIG_ADC_ASPEED=y
CONFIG_JTAG_ASPEED=y
CONFIG_PWM_ASPEED=n
CONFIG_TACH_ASPEED=n
CONFIG_ESPI_ASPEED=n
CONFIG_PECI_ASPEED=y
CONFIG_PECI_ASPEED_INTERRUPT_DRIVEN=y
CONFIG_USB_ASPEED=y
CONFIG_I3C_ASPEED=n
CONFIG_CRYPTO=n
CONFIG_CRYPTO_ASPEED=n
CONFIG_RSA_ASPEED=n
CONFIG_SNOOP_ASPEED=y
CONFIG_WDT_ASPEED=y

CONFIG_ADC_ASPEED_ACQUISITION_THREAD_STACK_SIZE=512
CONFIG_SYSTEM_WORKQUEUE_STACK_SIZE=2048
CONFIG_IDLE_STACK_SIZE=512
```

## meta-facebook/yv3-dl/sample.yaml
```yaml
tests:
  portability.cmsis_rtos_v2:
    tags: cmsis_rtos
sample:
  description: yv3_tmp 
  name: tmp
common:
    tags: introduction
```

## meta-facebook/yv3-vf/boards/ast1030_evb.conf
```kconfig
CONFIG_GPIO_ASPEED=y
CONFIG_SPI_ASPEED=y
CONFIG_I2C_ASPEED=y
CONFIG_ADC_ASPEED=y
CONFIG_WDT_ASPEED=y
```

## meta-facebook/yv35-hd/boards/ast1030_evb.conf
```kconfig
CONFIG_GPIO_ASPEED=y
CONFIG_SPI_ASPEED=y
CONFIG_I2C_ASPEED=y
CONFIG_ADC_ASPEED=y
CONFIG_JTAG_ASPEED=y
CONFIG_ESPI_ASPEED=y
CONFIG_USB_ASPEED=y
CONFIG_WDT_ASPEED=y
CONFIG_PCC_ASPEED=y
CONFIG_CRYPTO=y
CONFIG_CRYPTO_ASPEED=y

CONFIG_ADC_ASPEED_ACQUISITION_THREAD_STACK_SIZE=512
CONFIG_SYSTEM_WORKQUEUE_STACK_SIZE=2048
CONFIG_IDLE_STACK_SIZE=512
```

## meta-facebook/yv35-ji/boards/ast1030_evb.conf
```kconfig
CONFIG_GPIO_ASPEED=y
CONFIG_SPI_ASPEED=y
CONFIG_I2C_ASPEED=y
CONFIG_ADC_ASPEED=y
CONFIG_JTAG_ASPEED=y
CONFIG_USB_ASPEED=y
CONFIG_I3C_ASPEED=y
CONFIG_CRYPTO=n
CONFIG_CRYPTO_ASPEED=n
CONFIG_WDT_ASPEED=y

CONFIG_ADC_ASPEED_ACQUISITION_THREAD_STACK_SIZE=512
CONFIG_SYSTEM_WORKQUEUE_STACK_SIZE=4096
CONFIG_IDLE_STACK_SIZE=512
```

## meta-facebook/yv35-wf/boards/ast1030_evb.conf
```kconfig
CONFIG_GPIO_ASPEED_SGPIOM=n
CONFIG_GPIO_ASPEED=y
CONFIG_SPI_ASPEED=y
CONFIG_I2C_ASPEED=y
CONFIG_ADC_ASPEED=y
CONFIG_JTAG_ASPEED=n
CONFIG_PWM_ASPEED=n
CONFIG_TACH_ASPEED=n
CONFIG_ESPI_ASPEED=n
CONFIG_PECI_ASPEED=n
CONFIG_PECI_ASPEED_INTERRUPT_DRIVEN=n
CONFIG_USB_ASPEED=n
CONFIG_I3C_ASPEED=n
CONFIG_CRYPTO=n
CONFIG_CRYPTO_ASPEED=n
CONFIG_RSA_ASPEED=n
CONFIG_WDT_ASPEED=y
```

## src/Kconfig
```kconfig
mainmenu "miniBMC Configuration"
source	"include/Kconfig"
source	"app/Kconfig"
source	"drivers/Kconfig"
source	"libraries/Kconfig"


menuconfig OTP_MEM
	bool "OTP Memory"

if OTP_MEM

config OTP_CONFIG
	string "OTP config file path"

config OTP_KEY_FOLDER
	string "OTP key folder path"

config OTP_USER_DATA_FOLDER
	string "OTP user data folder path"

config OTP_FPGA
	bool "Padding OTP image to boot image for FPGA verifing"
endif #OTP_MEM


menuconfig SB_ENABLE
	bool "Secure Boot"

if SB_ENABLE

choice
	prompt "Secure Boot Mode"

config SB_MODE_2
	bool "Mode 2"

config SB_MODE_GCM
	bool "Mode GCM"

endchoice

# Mode 2
menuconfig SB_MODE_2_AES
	bool "Secure Boot Mode 2 Enable Encryption"
	depends on SB_MODE_2

if SB_MODE_2_AES

choice
	prompt "Mode 2 Encryption Mode Option"

config SB_MODE_2_O1
	bool "Option 1"

config SB_MODE_2_O2
	bool "Option 2"

endchoice

config SB_AES_KEY
	string "AES key path"

config SB_RSA_AES_KEY
	string "RSA key path for encrypting AES key"
	depends on SB_MODE_2_O2

endif #SB_MODE_2_AES

choice
	prompt "Mode 2 RSA length"
	depends on SB_MODE_2

config SB_RSA_1024
	bool "RSA1024"

config SB_RSA_2048
	bool "RSA2048"

config SB_RSA_3072
	bool "RSA3072"

config SB_RSA_4096
	bool "RSA4096"

endchoice

choice
	prompt "Mode 2 SHA length"
	depends on SB_MODE_2

config SB_SHA_224
	bool "SHA224"

config SB_SHA_256
	bool "SHA256"

config SB_SHA_384
	bool "SHA384"

config SB_SHA_512
	bool "SHA512"

endchoice

config SB_RSA_KEY
	string "RSA key path for signing"
	depends on SB_MODE_2

# Mode GCM
config SB_GCM_AES_KEY
	string "Mode GCM AES key path"
	depends on SB_MODE_GCM

endif #SB_ENABLE
```

## src/app/Kconfig
```kconfig
menu "Aspeed commands"
config CMD_MEM
	bool "memory access command"
	default y

config CMD_CLK
	bool "clock related commands"
	default y
endmenu

menu "Demo APPs"
config DEMO_TASK_SW
	bool "demo task switch"
	default n

config DEMO_GPIO
	bool "demo GPIO device"
	depends on DEVICE_GPIO || DEVICE_SGPIOM
	default n

config DEMO_I2C
	bool "demo I2C device"
	depends on DEVICE_I2C
	default n

config DEMO_I3C
	bool "demo I3C device"
	depends on DEVICE_I3C
	default n

if DEMO_I3C
	choice
	prompt "topologies"
	default DEMO_I3C_CASE_3

	config DEMO_I3C_CASE_1
		bool "case 1: Aspeed i3c master + Renesas slave devices"

	config DEMO_I3C_CASE_2
		bool "case 2: Stand alone Aspeed i3c slave"

	config DEMO_I3C_CASE_3
		bool "case 3: Aspeed i3c master + Aspeed i3c slave"
	endchoice
endif

config DEMO_ESPI
	bool "demo ESPI"
	depends on DEVICE_ESPI
	
config DEMO_PECI
	bool "demo PECI device"
	depends on DEVICE_PECI
	default n

config DEMO_PWM_TACH
	bool "demo PWM/TACH device"
	depends on DEVICE_PWM_TACH
	default n

config DEMO_ADC
	bool "demo ADC device"
	depends on DEVICE_ADC
	default n

config DEMO_JTAG
	bool "demo JTAG device"
	depends on DEVICE_JTAG
	default n

config SVF
	bool "demo svf player"
	depends on DEVICE_USB
	depends on DEVICE_JTAG
	depends on DEMO_JTAG
	default n

config DEMO_KCS
	bool "demo KCS device"
	depends on DEVICE_KCS
	default n

config DEMO_BT
	bool "demo BT device"
	depends on DEVICE_BT
	default n

config DEMO_SNOOP
	bool "demo Snoop device"
	depends on DEVICE_SNOOP
	default n

config DEMO_PCC
	bool "demo PCC device"
	depends on DEVICE_PCC
	default n

config DEMO_USB
	bool "demo USB device"
	depends on DEVICE_USB
	default n

config DEMO_CMB
	bool "demo CmBacktrace library"
	depends on LIBRARIES_CMBACKTRACE
	default n

config DEMO_NET
	bool "enable Ethernet test command"
	default n

config DEMO_MDIO
	bool "enable mdio command"
	depends on DEMO_NET
	default y

config DEMO_FMC_SPI
	bool "demo fmc/spi device"
	depends on DEVICE_FMC_SPI
	default n

config DEMO_RSA
	bool "demo rsa device"
	depends on DEVICE_CRYPTO
	default n

config DEMO_VUART
	bool "demo VUART device"
	depends on DEVICE_SERIAL
	default n

endmenu
```

## src/arch/arm/Kconfig
```kconfig
if ARCH_ASPEED
config SOC_VENDOR
	default "aspeed"

source "arch/arm/aspeed/Kconfig"
endif
```

## src/arch/arm/aspeed/Kconfig
```kconfig
choice
	prompt "SOC series"	
	default AST2600_SERIES
config AST2600_SERIES
	bool "ast2600 series"
config AST1030_SERIES
	bool "ast1030 series"		
endchoice

choice
	prompt "SOC ID"
	default AST2600A1
config AST2600A0
	bool "ast2600a0"
	depends on AST2600_SERIES
config AST2600A1
	bool "ast2600a1"
	depends on AST2600_SERIES
config AST2600A2
	bool "ast2600a2"
	depends on AST2600_SERIES
config AST1030A0
	bool "ast1030a0"
	depends on AST1030_SERIES
endchoice

config CPU_ID
	string

config CPU_ARCH
	string

config FPU_SELECT
	string

config SOC_INCLUDE_FILE
	string

if AST2600_SERIES
source "arch/arm/aspeed/ast2600/Kconfig"
endif
if AST1030_SERIES
source "arch/arm/aspeed/ast1030/Kconfig"
endif
```

## src/arch/arm/aspeed/ast1030/Kconfig
```kconfig
config CPU_ID
        default "cortex-m4"

config CPU_ARCH
        default "armv7e-m"

config FPU_SELECT
	default "-mfloat-abi=hard -mfpu=fpv4-sp-d16"

config SOC_INCLUDE_FILE
	default "ast1030.h"
```

## src/arch/arm/aspeed/ast2600/Kconfig
```kconfig
config CPU_ID
        default "cortex-m3"

config CPU_ARCH
        default "armv7-m"

config FPU_SELECT
	default ""

config SOC_INCLUDE_FILE
	default "ast2600.h"
```

## src/board/Kconfig
```kconfig
config BOARD_VENDOR
	string

config BOARD_NAME
	string

config IMG_NAME
	string

source "board/evb-ast2600/Kconfig"
source "board/evb-ast2605/Kconfig"
source "board/fpga-ast2600/Kconfig"
source "board/evb-ast1030/Kconfig"
source "board/fpga-ast1030/Kconfig"
source "board/yv35-cl/Kconfig"
```

## src/board/evb-ast1030/Kconfig
```kconfig
if TARGET_EVB_AST1030
config BOARD_VENDOR
	default "aspeed"

config BOARD_NAME
	default "evb-ast1030"

config IMG_NAME
	default "ast1030_bic.bin"

config ARM_ICE
	bool "Arm ICE debug enable"
	default y
endif
```

## src/board/evb-ast2600/Kconfig
```kconfig
if TARGET_EVB_AST2600
config BOARD_VENDOR
	default "aspeed"

config BOARD_NAME
	default "evb-ast2600"

config IMG_NAME
	default "ast2600_ssp.bin"

config ARM_ICE
	bool "Arm ICE debug enable"
	default y
endif
```

## src/board/evb-ast2605/Kconfig
```kconfig
if TARGET_EVB_AST2605
config BOARD_VENDOR
	default "aspeed"

config BOARD_NAME
	default "evb-ast2605"

config IMG_NAME
	default "ast2605_ssp.bin"

endif
```

## src/board/fpga-ast1030/Kconfig
```kconfig
if TARGET_FPGA_AST1030
config BOARD_VENDOR
	default "aspeed"

config BOARD_NAME
	default "fpga-ast1030"

config IMG_NAME
	default "ast1030_bic.bin"

endif
```
